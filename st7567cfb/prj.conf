## CMakeLists.txt
```
cmake_minimum_required(VERSION 3.20.0)
find_package(Zephyr REQUIRED HINTS $ENV{ZEPHYR_BASE})
project(st7567)
target_sources(app PRIVATE src/main.c)
```

## prj.conf
```kconfig
CONFIG_GPIO=y
CONFIG_SPI=y
CONFIG_HEAP_MEM_POOL_SIZE=32678
CONFIG_MAIN_STACK_SIZE=4096

CONFIG_LOG=y
CONFIG_DISPLAY=y
CONFIG_ST7567=y
CONFIG_ST7567_DEFAULT_CONTRAST=0
CONFIG_MIPI_DBI=y
CONFIG_MIPI_DBI_SPI=y
CONFIG_CHARACTER_FRAMEBUFFER=y


CONFIG_USB_DEVICE_STACK=y
CONFIG_USB_DEVICE_PRODUCT="Zephyr Weather Station"
CONFIG_USB_DEVICE_PID=0x0004
CONFIG_USB_CDC_ACM=y
CONFIG_USB_DEVICE_INITIALIZE_AT_BOOT=y
CONFIG_CONSOLE=y
CONFIG_SERIAL=y
CONFIG_UART_CONSOLE=y
```

## src/main.c
```c
#include <zephyr/kernel.h>
#include <zephyr/device.h>
#include <zephyr/drivers/display.h>
#include <zephyr/display/cfb.h>

int main() {
    printk("** Starting ST7567 CFB test **\n");

    const struct device *display_dev;
    display_dev = DEVICE_DT_GET(DT_CHOSEN(zephyr_display));

    if (!device_is_ready(display_dev)) {
        printk("Display device not ready!\n");
        return -1;
    }

    // Initialize CFB
    if (display_set_pixel_format(display_dev, PIXEL_FORMAT_MONO10) != 0) {
        printk("Failed to set pixel format\n");
    }

    if (display_set_contrast(display_dev, 0)) {
        printk("Failed to set contrast\n");
    }

    if (cfb_framebuffer_init(display_dev)) {
        printk("CFB init failed!\n");
        return -1;
    }

    cfb_framebuffer_clear(display_dev, true);
    display_blanking_off(display_dev);

    // Print available fonts
    uint8_t font_count = cfb_get_numof_fonts(display_dev);
    printk("Available fonts: %d\n", font_count);
    for (uint8_t i = 0; i < font_count; ++i) {
        uint8_t w, h;
        cfb_get_font_size(display_dev, i, &w, &h);
        printk("Font: %d %02dx%02d\n", i, w, h);
    }

    // Set font (try font 0)
    cfb_framebuffer_set_font(display_dev, 0);

    // Print hello world
    cfb_print(display_dev, "Hello World!", 0, 0);
    cfb_framebuffer_finalize(display_dev);

    printk("Done.\n");
    return 0;
}
```

## CMakeLists.txt
```
cmake_minimum_required(VERSION 3.20.0)
find_package(Zephyr REQUIRED HINTS $ENV{ZEPHYR_BASE})
project(rtc)
target_sources(app PRIVATE src/main.c)
```

## prj.conf
```kconfig
# snprintf
CONFIG_MINIMAL_LIBC=y
CONFIG_DISPLAY=y
CONFIG_SSD1306=y
CONFIG_I2C=y
```

## src/main.c
```c
/* Demonstration code using XIAO expansion board with
 * PCF8563 RTC and SSD1306 display without LVGL
 * (Light and Versatile Graphics Library)
 * and universal RTC driver which does not work with wrong RTC time.
 * 
 * This simplifies the code, but somewhat violates best practices
 * and portability, because these things are defined in the code
 * rather than the device tree.
 *
 * Pavel Perina, 2025-07-13
 */

#include "font.h"

#include <stdio.h>

#include <zephyr/kernel.h>
#include <zephyr/device.h>
#include <zephyr/drivers/i2c.h>
#include <zephyr/drivers/display.h>

#define PCF8563_I2C_ADDR    0x51
#define PCF8563_REG_SECONDS 0x02

#define DISPLAY_WIDTH 128
#define DISPLAY_HEIGHT 64
#define DISPLAY_FB_SIZE (DISPLAY_WIDTH * DISPLAY_HEIGHT / 8)

/* The display the board/shield declares as zephyr,display (the SSD1306
 * on the XIAO expansion board). Not DEVICE_DT_GET_ONE(solomon_ssd1306fb):
 * that compatible was renamed to solomon,ssd1306 in newer Zephyr.
 */
const struct device *display = DEVICE_DT_GET(DT_CHOSEN(zephyr_display));
const struct device *i2c_dev = DEVICE_DT_GET(DT_NODELABEL(xiao_i2c));

struct display_buffer_descriptor display_descriptor = {
    .width = DISPLAY_WIDTH,
    .height = DISPLAY_HEIGHT,
    .pitch = DISPLAY_WIDTH,
    .buf_size = DISPLAY_FB_SIZE
};

uint8_t framebuffer[DISPLAY_FB_SIZE] = { 0 };

void fb_clear(void) 
{
    memset(framebuffer, 0, DISPLAY_FB_SIZE);
}

void fb_write(int row, int x, const char *text) {
    int dst_index = row * DISPLAY_WIDTH + x;
    while (*text) {
        uint16_t ch = (uint8_t)(*text);
        int src_index = ch * 6;
        for (int i = 0; i < 6; i++) {
            if (dst_index >= DISPLAY_FB_SIZE)
                return;
            framebuffer[dst_index++] = font_data[src_index + i];
        }
        text++;
    }
}

static uint8_t bcd_to_bin(uint8_t bcd) {
    return (bcd >> 4) * 10 + (bcd & 0x0F);
}


int main(void)
{
    if (!device_is_ready(i2c_dev)) {
        printk("I2C device not ready\n");
        return -1;
    }
    if (!device_is_ready(display)) {
        printk("Display device not ready\n");
        return -1;
    }

    char buf[32];
    uint8_t time_data[7];

    while (1) {
        // Read 6 bytes: seconds, minutes, hours, day, month, year
        int ret = i2c_burst_read(i2c_dev, PCF8563_I2C_ADDR, PCF8563_REG_SECONDS, time_data, 7);
        if (ret < 0) {
            fb_write(0,0,"I2C read failed");
            snprintf(buf, sizeof(buf), "Error: %d", ret);
            fb_write(1,0, buf);
        } else {
            fb_write(0, 0, "Hello Zephyr!");

            snprintf(buf, sizeof(buf), "Date: 20%02d-%02d-%02d", 
			    bcd_to_bin(time_data[6]), 
			    bcd_to_bin(time_data[5] & 0x0f),
			    bcd_to_bin(time_data[3] & 0x3f));
            fb_write(1, 0, buf);

            snprintf(buf, sizeof(buf), "Time:   %02d:%02d:%02d",
			    bcd_to_bin(time_data[2] & 0x3f), 
			    bcd_to_bin(time_data[1] & 0x7f), 
			    bcd_to_bin(time_data[0] & 0x7f));
            fb_write(2, 0, buf);

	    if ((time_data[0] & 0x80) != 0) {
		    fb_write(3, 0, "Bad integrity");
	    }
        }
	display_write(display, 0, 0, &display_descriptor, framebuffer);
	display_blanking_off(display);

        k_sleep(K_SECONDS(1));
    }
    return 0;
}
```

## src/font.h
```c
/* Font converted from Bm437_HP_100LX_6x8.otb */

#pragma once

#include <stdint.h>

static const uint8_t font_data[256*6] = {
    0x00, 0x00, 0x00, 0x00, 0x00, 0x00,     // 0
    0x00, 0x3E, 0x45, 0x51, 0x45, 0x3E,     // 1
    0x00, 0x3E, 0x7B, 0x6F, 0x7B, 0x3E,     // 2
    0x00, 0x1C, 0x3E, 0x7C, 0x3E, 0x1C,     // 3
    0x00, 0x18, 0x3C, 0x7E, 0x3C, 0x18,     // 4
    0x00, 0x18, 0x5E, 0x6E, 0x5E, 0x18,     // 5
    0x00, 0x18, 0x5C, 0x6E, 0x5C, 0x18,     // 6
    0x00, 0x00, 0x18, 0x18, 0x00, 0x00,     // 7
    0xFF, 0xFF, 0xE7, 0xE7, 0xFF, 0xFF,     // 8
    0x00, 0x18, 0x24, 0x24, 0x18, 0x00,     // 9
    0xFF, 0xE7, 0xDB, 0xDB, 0xE7, 0xFF,     // 10
    0x70, 0x88, 0x88, 0x8D, 0x73, 0x07,     // 11
    0x00, 0x0E, 0x51, 0xF1, 0x51, 0x0E,     // 12
    0x00, 0x60, 0x60, 0x3F, 0x02, 0x04,     // 13
    0x60, 0x60, 0x3F, 0xC5, 0xCA, 0x7C,     // 14
    0x00, 0x2A, 0x1C, 0x36, 0x1C, 0x2A,     // 15
    0x00, 0x3E, 0x3E, 0x1C, 0x1C, 0x08,     // 16
    0x00, 0x08, 0x1C, 0x1C, 0x3E, 0x3E,     // 17
    0x00, 0x14, 0x36, 0x7F, 0x36, 0x14,     // 18
    0x00, 0x00, 0x5F, 0x00, 0x5F, 0x00,     // 19
    0x00, 0x06, 0x09, 0x7F, 0x01, 0x7F,     // 20
    0x40, 0x9A, 0xA5, 0xA5, 0x59, 0x02,     // 21
    0x00, 0xE0, 0xE0, 0xE0, 0xE0, 0xE0,     // 22
    0x00, 0x94, 0xB6, 0xFF, 0xB6, 0x94,     // 23
    0x00, 0x08, 0x0C, 0xFE, 0x0C, 0x08,     // 24
    0x00, 0x10, 0x30, 0x7F, 0x30, 0x10,     // 25
    0x08, 0x08, 0x08, 0x3E, 0x1C, 0x08,     // 26
    0x08, 0x1C, 0x3E, 0x08, 0x08, 0x08,     // 27
    0x00, 0x0F, 0x08, 0x08, 0x08, 0x08,     // 28
    0x08, 0x1C, 0x08, 0x08, 0x1C, 0x08,     // 29
    0x00, 0x60, 0x78, 0x7E, 0x78, 0x60,     // 30
    0x00, 0x06, 0x1E, 0x7E, 0x1E, 0x06,     // 31
    0x00, 0x00, 0x00, 0x00, 0x00, 0x00,     // 32
    0x00, 0x00, 0x00, 0x5F, 0x00, 0x00,     // 33
    0x00, 0x00, 0x07, 0x00, 0x07, 0x00,     // 34
    0x00, 0x14, 0x7F, 0x14, 0x7F, 0x14,     // 35
    0x00, 0x24, 0x2A, 0x6B, 0x2A, 0x12,     // 36
    0x00, 0x22, 0x15, 0x2A, 0x54, 0x22,     // 37
    0x00, 0x36, 0x49, 0x56, 0x20, 0x50,     // 38
    0x00, 0x00, 0x0B, 0x07, 0x00, 0x00,     // 39
    0x00, 0x00, 0x3E, 0x41, 0x00, 0x00,     // 40
    0x00, 0x00, 0x00, 0x41, 0x3E, 0x00,     // 41
    0x00, 0x08, 0x2A, 0x1C, 0x2A, 0x08,     // 42
    0x00, 0x08, 0x08, 0x3E, 0x08, 0x08,     // 43
    0x00, 0x00, 0xA0, 0x60, 0x00, 0x00,     // 44
    0x00, 0x08, 0x08, 0x08, 0x08, 0x08,     // 45
    0x00, 0x00, 0x60, 0x60, 0x00, 0x00,     // 46
    0x00, 0x60, 0x30, 0x18, 0x0C, 0x06,     // 47
    0x00, 0x3E, 0x51, 0x49, 0x45, 0x3E,     // 48
    0x00, 0x00, 0x42, 0x7F, 0x40, 0x00,     // 49
    0x00, 0x62, 0x51, 0x49, 0x49, 0x46,     // 50
    0x00, 0x22, 0x49, 0x49, 0x49, 0x36,     // 51
    0x00, 0x18, 0x14, 0x52, 0x7F, 0x50,     // 52
    0x00, 0x27, 0x45, 0x45, 0x45, 0x39,     // 53
    0x00, 0x3C, 0x4A, 0x49, 0x49, 0x30,     // 54
    0x00, 0x01, 0x01, 0x79, 0x05, 0x03,     // 55
    0x00, 0x36, 0x49, 0x49, 0x49, 0x36,     // 56
    0x00, 0x06, 0x49, 0x49, 0x29, 0x1E,     // 57
    0x00, 0x00, 0x6C, 0x6C, 0x00, 0x00,     // 58
    0x00, 0x00, 0xAC, 0x6C, 0x00, 0x00,     // 59
    0x00, 0x08, 0x14, 0x22, 0x41, 0x00,     // 60
    0x00, 0x14, 0x14, 0x14, 0x14, 0x14,     // 61
    0x00, 0x00, 0x41, 0x22, 0x14, 0x08,     // 62
    0x00, 0x06, 0x01, 0x51, 0x09, 0x06,     // 63
    0x00, 0x3E, 0x41, 0x5D, 0x55, 0x5E,     // 64
    0x00, 0x7E, 0x11, 0x11, 0x11, 0x7E,     // 65
    0x00, 0x7F, 0x49, 0x49, 0x49, 0x36,     // 66
    0x00, 0x3E, 0x41, 0x41, 0x41, 0x22,     // 67
    0x00, 0x7F, 0x41, 0x41, 0x22, 0x1C,     // 68
    0x00, 0x7F, 0x49, 0x49, 0x49, 0x41,     // 69
    0x00, 0x7F, 0x09, 0x09, 0x09, 0x01,     // 70
    0x00, 0x3E, 0x41, 0x41, 0x51, 0x72,     // 71
    0x00, 0x7F, 0x08, 0x08, 0x08, 0x7F,     // 72
    0x00, 0x00, 0x41, 0x7F, 0x41, 0x00,     // 73
    0x00, 0x30, 0x40, 0x40, 0x40, 0x3F,     // 74
    0x00, 0x7F, 0x08, 0x14, 0x22, 0x41,     // 75
    0x00, 0x7F, 0x40, 0x40, 0x40, 0x40,     // 76
    0x00, 0x7F, 0x06, 0x18, 0x06, 0x7F,     // 77
    0x00, 0x7F, 0x06, 0x08, 0x30, 0x7F,     // 78
    0x00, 0x3E, 0x41, 0x41, 0x41, 0x3E,     // 79
    0x00, 0x7F, 0x09, 0x09, 0x09, 0x06,     // 80
    0x00, 0x3E, 0x41, 0x51, 0x21, 0x5E,     // 81
    0x00, 0x7F, 0x09, 0x09, 0x19, 0x66,     // 82
    0x00, 0x26, 0x49, 0x49, 0x49, 0x32,     // 83
    0x00, 0x01, 0x01, 0x7F, 0x01, 0x01,     // 84
    0x00, 0x3F, 0x40, 0x40, 0x40, 0x3F,     // 85
    0x00, 0x07, 0x18, 0x60, 0x18, 0x07,     // 86
    0x00, 0x7F, 0x20, 0x18, 0x20, 0x7F,     // 87
    0x00, 0x63, 0x14, 0x08, 0x14, 0x63,     // 88
    0x00, 0x03, 0x0C, 0x78, 0x0C, 0x03,     // 89
    0x00, 0x61, 0x51, 0x49, 0x45, 0x43,     // 90
    0x00, 0x00, 0x7F, 0x41, 0x41, 0x00,     // 91
    0x00, 0x06, 0x0C, 0x18, 0x30, 0x60,     // 92
    0x00, 0x00, 0x41, 0x41, 0x7F, 0x00,     // 93
    0x00, 0x04, 0x02, 0x01, 0x02, 0x04,     // 94
    0x80, 0x80, 0x80, 0x80, 0x80, 0x80,     // 95
    0x00, 0x00, 0x00, 0x01, 0x02, 0x00,     // 96
    0x00, 0x20, 0x54, 0x54, 0x54, 0x78,     // 97
    0x00, 0x7F, 0x28, 0x44, 0x44, 0x38,     // 98
    0x00, 0x38, 0x44, 0x44, 0x44, 0x28,     // 99
    0x00, 0x38, 0x44, 0x44, 0x28, 0x7F,     // 100
    0x00, 0x38, 0x54, 0x54, 0x54, 0x18,     // 101
    0x00, 0x08, 0x7E, 0x09, 0x01, 0x02,     // 102
    0x00, 0x18, 0xA4, 0xA4, 0xA8, 0x7C,     // 103
    0x00, 0x7F, 0x08, 0x04, 0x04, 0x78,     // 104
    0x00, 0x00, 0x44, 0x7D, 0x40, 0x00,     // 105
    0x00, 0x40, 0x80, 0x84, 0x7D, 0x00,     // 106
    0x00, 0x7F, 0x10, 0x28, 0x44, 0x00,     // 107
    0x00, 0x00, 0x41, 0x7F, 0x40, 0x00,     // 108
    0x00, 0x7C, 0x04, 0x78, 0x04, 0x78,     // 109
    0x00, 0x7C, 0x08, 0x04, 0x04, 0x78,     // 110
    0x00, 0x38, 0x44, 0x44, 0x44, 0x38,     // 111
    0x00, 0xFC, 0x28, 0x44, 0x44, 0x38,     // 112
    0x00, 0x38, 0x44, 0x44, 0x28, 0xFC,     // 113
    0x00, 0x44, 0x78, 0x44, 0x04, 0x08,     // 114
    0x00, 0x48, 0x54, 0x54, 0x54, 0x24,     // 115
    0x00, 0x04, 0x3F, 0x44, 0x40, 0x20,     // 116
    0x00, 0x3C, 0x40, 0x40, 0x20, 0x7C,     // 117
    0x00, 0x1C, 0x20, 0x40, 0x20, 0x1C,     // 118
    0x00, 0x3C, 0x40, 0x30, 0x40, 0x3C,     // 119
    0x00, 0x44, 0x28, 0x10, 0x28, 0x44,     // 120
    0x00, 0x1C, 0xA0, 0xA0, 0xA0, 0x7C,     // 121
    0x00, 0x44, 0x64, 0x54, 0x4C, 0x44,     // 122
    0x00, 0x08, 0x36, 0x41, 0x41, 0x00,     // 123
    0x00, 0x00, 0x00, 0x7F, 0x00, 0x00,     // 124
    0x00, 0x00, 0x41, 0x41, 0x36, 0x08,     // 125
    0x00, 0x02, 0x01, 0x02, 0x04, 0x02,     // 126
    0x00, 0x78, 0x44, 0x42, 0x44, 0x78,     // 127
    0x00, 0xBE, 0xC1, 0xC1, 0x41, 0x22,     // 128
    0x00, 0x3C, 0x41, 0x40, 0x21, 0x7C,     // 129
    0x00, 0x38, 0x54, 0x56, 0x55, 0x18,     // 130
    0x00, 0x20, 0x56, 0x55, 0x56, 0x78,     // 131
    0x00, 0x20, 0x55, 0x54, 0x55, 0x78,     // 132
    0x00, 0x20, 0x55, 0x56, 0x54, 0x78,     // 133
    0x00, 0x20, 0x54, 0x55, 0x54, 0x78,     // 134
    0x00, 0xB8, 0xC4, 0xC4, 0x44, 0x28,     // 135
    0x00, 0x38, 0x56, 0x55, 0x56, 0x18,     // 136
    0x00, 0x38, 0x55, 0x54, 0x55, 0x18,     // 137
    0x00, 0x38, 0x55, 0x56, 0x54, 0x18,     // 138
    0x00, 0x00, 0x45, 0x7C, 0x41, 0x00,     // 139
    0x00, 0x00, 0x46, 0x7D, 0x42, 0x00,     // 140
    0x00, 0x00, 0x45, 0x7E, 0x40, 0x00,     // 141
    0x00, 0x7C, 0x13, 0x12, 0x13, 0x7C,     // 142
    0x00, 0x7C, 0x12, 0x13, 0x12, 0x7C,     // 143
    0x00, 0x7E, 0x4A, 0x4B, 0x4B, 0x43,     // 144
    0x00, 0x74, 0x54, 0x78, 0x54, 0x5C,     // 145
    0x00, 0x7E, 0x09, 0x7E, 0x49, 0x49,     // 146
    0x00, 0x38, 0x46, 0x45, 0x46, 0x38,     // 147
    0x00, 0x38, 0x45, 0x44, 0x45, 0x38,     // 148
    0x00, 0x38, 0x45, 0x46, 0x44, 0x38,     // 149
    0x00, 0x3C, 0x42, 0x41, 0x22, 0x7C,     // 150
    0x00, 0x3C, 0x41, 0x42, 0x20, 0x7C,     // 151
    0x00, 0x1C, 0xA1, 0xA0, 0xA1, 0x7C,     // 152
    0x00, 0x3C, 0x43, 0x42, 0x43, 0x3C,     // 153
    0x00, 0x3E, 0x41, 0x40, 0x41, 0x3E,     // 154
    0x00, 0x38, 0x44, 0xC6, 0x44, 0x28,     // 155
    0x00, 0x48, 0x7E, 0x49, 0x49, 0x42,     // 156
    0x00, 0x29, 0x2A, 0xFC, 0x2A, 0x29,     // 157
    0x00, 0x7F, 0x09, 0x29, 0xF6, 0xA0,     // 158
    0x00, 0x40, 0x88, 0x7E, 0x09, 0x02,     // 159
    0x00, 0x20, 0x54, 0x56, 0x55, 0x78,     // 160
    0x00, 0x00, 0x44, 0x7E, 0x41, 0x00,     // 161
    0x00, 0x38, 0x44, 0x46, 0x45, 0x38,     // 162
    0x00, 0x3C, 0x40, 0x42, 0x21, 0x7C,     // 163
    0x00, 0x7C, 0x09, 0x05, 0x05, 0x78,     // 164
    0x00, 0x7E, 0x0D, 0x19, 0x31, 0x7E,     // 165
    0x00, 0x26, 0x29, 0x29, 0x27, 0x28,     // 166
    0x00, 0x26, 0x29, 0x29, 0x26, 0x00,     // 167
    0x00, 0x30, 0x48, 0x45, 0x40, 0x30,     // 168
    0x00, 0x78, 0x08, 0x08, 0x08, 0x08,     // 169
    0x08, 0x08, 0x08, 0x08, 0x78, 0x00,     // 170
    0x00, 0x17, 0x08, 0x04, 0x6A, 0x58,     // 171
    0x00, 0x17, 0x08, 0x34, 0x22, 0x70,     // 172
    0x00, 0x00, 0x00, 0x7D, 0x00, 0x00,     // 173
    0x08, 0x14, 0x22, 0x08, 0x14, 0x22,     // 174
    0x22, 0x14, 0x08, 0x22, 0x14, 0x08,     // 175
    0x11, 0x44, 0x11, 0x44, 0x11, 0x44,     // 176
    0x55, 0xAA, 0x55, 0xAA, 0x55, 0xAA,     // 177
    0xEE, 0xBB, 0xEE, 0xBB, 0xEE, 0xBB,     // 178
    0x00, 0x00, 0x00, 0xFF, 0x00, 0x00,     // 179
    0x08, 0x08, 0x08, 0xFF, 0x00, 0x00,     // 180
    0x14, 0x14, 0x14, 0xFF, 0x00, 0x00,     // 181
    0x08, 0x08, 0xFF, 0x00, 0xFF, 0x00,     // 182
    0x08, 0x08, 0xF8, 0x08, 0xF8, 0x00,     // 183
    0x14, 0x14, 0x14, 0xFC, 0x00, 0x00,     // 184
    0x14, 0x14, 0xF7, 0x00, 0xFF, 0x00,     // 185
    0x00, 0x00, 0xFF, 0x00, 0xFF, 0x00,     // 186
    0x14, 0x14, 0xF4, 0x04, 0xFC, 0x00,     // 187
    0x14, 0x14, 0x17, 0x10, 0x1F, 0x00,     // 188
    0x08, 0x08, 0x0F, 0x08, 0x0F, 0x00,     // 189
    0x14, 0x14, 0x14, 0x1F, 0x00, 0x00,     // 190
    0x08, 0x08, 0x08, 0xF8, 0x00, 0x00,     // 191
    0x00, 0x00, 0x00, 0x0F, 0x08, 0x08,     // 192
    0x08, 0x08, 0x08, 0x0F, 0x08, 0x08,     // 193
    0x08, 0x08, 0x08, 0xF8, 0x08, 0x08,     // 194
    0x00, 0x00, 0x00, 0xFF, 0x08, 0x08,     // 195
    0x08, 0x08, 0x08, 0x08, 0x08, 0x08,     // 196
    0x08, 0x08, 0x08, 0xFF, 0x08, 0x08,     // 197
    0x00, 0x00, 0x00, 0xFF, 0x14, 0x14,     // 198
    0x00, 0x00, 0xFF, 0x00, 0xFF, 0x08,     // 199
    0x00, 0x00, 0x1F, 0x10, 0x17, 0x14,     // 200
    0x00, 0x00, 0xFC, 0x04, 0xF4, 0x14,     // 201
    0x14, 0x14, 0x17, 0x10, 0x17, 0x14,     // 202
    0x14, 0x14, 0xF4, 0x04, 0xF4, 0x14,     // 203
    0x00, 0x00, 0xFF, 0x00, 0xF7, 0x14,     // 204
    0x14, 0x14, 0x14, 0x14, 0x14, 0x14,     // 205
    0x14, 0x14, 0xF7, 0x00, 0xF7, 0x14,     // 206
    0x14, 0x14, 0x14, 0x17, 0x14, 0x14,     // 207
    0x08, 0x08, 0x0F, 0x08, 0x0F, 0x08,     // 208
    0x14, 0x14, 0x14, 0xF4, 0x14, 0x14,     // 209
    0x08, 0x08, 0xF8, 0x08, 0xF8, 0x08,     // 210
    0x00, 0x00, 0x0F, 0x08, 0x0F, 0x08,     // 211
    0x00, 0x00, 0x00, 0x1F, 0x14, 0x14,     // 212
    0x00, 0x00, 0x00, 0xFC, 0x14, 0x14,     // 213
    0x00, 0x00, 0xF8, 0x08, 0xF8, 0x08,     // 214
    0x08, 0x08, 0xFF, 0x08, 0xFF, 0x08,     // 215
    0x14, 0x14, 0x14, 0xFF, 0x14, 0x14,     // 216
    0x08, 0x08, 0x08, 0x0F, 0x00, 0x00,     // 217
    0x00, 0x00, 0x00, 0xF8, 0x08, 0x08,     // 218
    0xFF, 0xFF, 0xFF, 0xFF, 0xFF, 0xFF,     // 219
    0xF0, 0xF0, 0xF0, 0xF0, 0xF0, 0xF0,     // 220
    0xFF, 0xFF, 0xFF, 0x00, 0x00, 0x00,     // 221
    0x00, 0x00, 0x00, 0xFF, 0xFF, 0xFF,     // 222
    0x0F, 0x0F, 0x0F, 0x0F, 0x0F, 0x0F,     // 223
    0x00, 0x38, 0x44, 0x44, 0x38, 0x44,     // 224
    0x40, 0x7C, 0x02, 0x4A, 0x4A, 0x34,     // 225
    0x00, 0x7F, 0x01, 0x01, 0x01, 0x01,     // 226
    0x04, 0x7C, 0x04, 0x04, 0x7C, 0x04,     // 227
    0x00, 0x63, 0x55, 0x49, 0x41, 0x41,     // 228
    0x00, 0x38, 0x44, 0x44, 0x4C, 0x34,     // 229
    0x00, 0xFC, 0x40, 0x40, 0x40, 0x7C,     // 230
    0x00, 0x08, 0x04, 0x7C, 0x08, 0x04,     // 231
    0x00, 0x1C, 0x63, 0x7F, 0x63, 0x1C,     // 232
    0x00, 0x3E, 0x49, 0x49, 0x49, 0x3E,     // 233
    0x00, 0x5E, 0x61, 0x01, 0x61, 0x5E,     // 234
    0x00, 0x38, 0x46, 0x45, 0x45, 0x3A,     // 235
    0x38, 0x44, 0x44, 0x38, 0x44, 0x38,     // 236
    0x00, 0x38, 0xC4, 0x7C, 0x46, 0x38,     // 237
    0x00, 0x1C, 0x2A, 0x49, 0x49, 0x00,     // 238
    0x00, 0x7E, 0x01, 0x01, 0x01, 0x7E,     // 239
    0x00, 0x2A, 0x2A, 0x2A, 0x2A, 0x2A,     // 240
    0x00, 0x48, 0x48, 0x7E, 0x48, 0x48,     // 241
    0x00, 0x00, 0xC1, 0xA2, 0x94, 0x88,     // 242
    0x00, 0x88, 0x94, 0xA2, 0xC1, 0x00,     // 243
    0x00, 0x00, 0x00, 0xFC, 0x02, 0x0C,     // 244
    0x00, 0x30, 0x40, 0x3F, 0x00, 0x00,     // 245
    0x00, 0x08, 0x08, 0x2A, 0x08, 0x08,     // 246
    0x00, 0x24, 0x12, 0x24, 0x48, 0x24,     // 247
    0x00, 0x06, 0x09, 0x09, 0x06, 0x00,     // 248
    0x00, 0x00, 0x18, 0x18, 0x00, 0x00,     // 249
    0x00, 0x00, 0x08, 0x00, 0x00, 0x00,     // 250
    0x10, 0x20, 0x40, 0xFF, 0x01, 0x01,     // 251
    0x00, 0x00, 0x0F, 0x02, 0x01, 0x0E,     // 252
    0x00, 0x00, 0x09, 0x0D, 0x0A, 0x00,     // 253
    0x00, 0x3C, 0x3C, 0x3C, 0x3C, 0x00,     // 254
    0x00, 0x00, 0x00, 0x00, 0x00, 0x00,     // 255
};
```
